/*
 * SSD1289.h
 *
 * Created: 12/23/2014 12:41:35 AM
 *  Author: Aman
 */

#ifndef SSD1289_H_
#define SSD1289_H_

// TFT display connections
#define TFT_WR_1 (PORTB |= (1<<PB1))
#define TFT_WR_0 (PORTB &= ~(1<<PB1))
#define TFT_RD_1 (PORTB |= (1<<PB2))
#define TFT_RD_0 (PORTB &= ~(1<<PB2))
#define TFT_CS_1 (PORTD |= (1<<PD4))
#define TFT_CS_0 (PORTD &= ~(1<<PD4))
#define TFT_RS_1 (PORTD |= (1<<PD5))
#define TFT_RS_0 (PORTD &= ~(1<<PD5))
#define TFT_RST_1 (PORTB |= (1<<PB3))
#define TFT_RST_0 (PORTB &= ~(1<<PB3))
// Warning: please set the data direction of the ports properly to work with this header file
// End of TFT display connections

#define black 0x0000
#define red 0xF800
#define green 0x07E0
#define blue 0x001F
#define white 0xFFFF
#define gray 0x8888
#define purple 0xF11F
#define yellow 0xFFE0
#define cyan 0x07FF

#include <util/delay.h>
#include <math.h>
#include <string.h>
#include <avr/pgmspace.h>

//display data write path define function
void TFT_DP_DATA(uint16_t Data)
{
	PORTC = (uint8_t) (Data & 0x00FF);
	PORTA = (uint8_t) ((Data & 0xFE00)>>8);
	if (Data & (1<<8)) PORTB |=(1<<0);
	else PORTB &=~(1<<0);
}

const uint16_t image_data_astex_logo[2500] PROGMEM = {
	0xfffe, 0xffdf, 0xffdf, 0xffff, 0xffff, 0xffff, 0xffdf, 0xffff, 0xf7ff, 0xf7ff, 0xffff, 0xffdf,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 0xffff,
	0xffdf, 0xffff, 0xffff, 0xffff, 0xffff, 0xffff, 0xffff, 0xffff, 0xffdf, 0xffff, 0xf7ff, 0xf7ff,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 0xffff,
	0xffdf, 0xffff, 0xf7ff, 0xfffe, 0xffff, 0xffff, 0xffff, 0xffff, 0xffdf, 0xffdf, 0xffff, 0xf7ff,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 0xffff,
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	0xffff, 0xffff, 0xffff, 0xffff, 0xffff, 0xffff, 0xffff, 0xffff, 0xffff, 0xffff, 0xffff, 0xffff,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 0xffff
};


/*working function familiarization can be added here*/
// help line: flash unsigned char smallFont[784] 

const char FONT_8x8[784] PROGMEM =
{
	0x00,0x00,0x00,0x00,0x00,0x00,0x00,0x00, // space 0x20
	0x30,0x78,0x78,0x30,0x30,0x00,0x30,0x00, // !
	0x6C,0x6C,0x6C,0x00,0x00,0x00,0x00,0x00, // "
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	0x22,0x77,0x7f,0x7f,0x3e,0x1c,0x08,0x00  // HEART use:�
};


const char FONT_16x16[3040] PROGMEM = {
	0x00,0x00,0x00,0x00,0x00,0x00,0x00,0x00,0x00,0x00,0x00,0x00,0x00,0x00,0x00,0x00,0x00,0x00,0x00,0x00,0x00,0x00,0x00,0x00,0x00,0x00,0x00,0x00,0x00,0x00,0x00,0x00, //  <Space>
	0x00,0x00,0x00,0x00,0x07,0x00,0x0F,0x80,0x0F,0x80,0x0F,0x80,0x0F,0x80,0x0F,0x80,0x07,0x00,0x07,0x00,0x00,0x00,0x00,0x00,0x07,0x00,0x07,0x00,0x07,0x00,0x00,0x00, // !
	0x00,0x00,0x0E,0x38,0x0E,0x38,0x0E,0x38,0x0E,0x38,0x06,0x30,0x00,0x00,0x00,0x00,0x00,0x00,0x00,0x00,0x00,0x00,0x00,0x00,0x00,0x00,0x00,0x00,0x00,0x00,0x00,0x00, // "
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	0x00,0x00,0x00,0x00,0x1F,0x1C,0x3B,0x9C,0x39,0xDC,0x38,0xF8,0x00,0x00,0x00,0x00,0x00,0x00,0x00,0x00,0x00,0x00,0x00,0x00,0x00,0x00,0x00,0x00,0x00,0x00,0x00,0x00  // ~
};



void Write_Command(uint16_t Wcommand)
{
	TFT_RD_1;
	TFT_RS_0;
	TFT_DP_DATA(Wcommand);
	TFT_WR_0;
	TFT_WR_1;
}

void Write_Data(uint16_t Wdata)
{
		TFT_RD_1;
		TFT_RS_1;
		TFT_DP_DATA(Wdata);
		TFT_WR_0;
		TFT_WR_1;
}

void Write_Command_Data(uint16_t Wcommand, uint16_t Wdata)
{
	Write_Command(Wcommand);
	Write_Data(Wdata);
}

void TFT_Set_Address(uint16_t PX1, uint16_t PY1, uint16_t PX2, uint16_t PY2)
{
	Write_Command_Data(0x0044,(PX2 << 8) + PX1 );	//Column address start2
	Write_Command_Data(0x0045,PY1);					//Column address start1
	Write_Command_Data(0x0046,PY2);					//Column address end2
	Write_Command_Data(0x004E,PX1);					//Column address end1
	Write_Command_Data(0x004F,PY1);					//Row address start2
	Write_Command(0x0022);
}

void TFT_Init(void)
{
	TFT_RD_1;
	TFT_RST_1;
	_delay_ms(5);
	TFT_RST_0;
	_delay_ms(15);
	TFT_RST_1;
	_delay_ms(15);
	TFT_CS_0;
	Write_Command_Data(0x0000,0x0001);
	Write_Command_Data(0x0003,0xA8A4);
	Write_Command_Data(0x000C,0x0000);
	Write_Command_Data(0x000D,0x800C);
	Write_Command_Data(0x000E,0x2B00);
	Write_Command_Data(0x001E,0x00B7);
	Write_Command_Data(0x0001,0x2B3F);
	Write_Command_Data(0x0002,0x0600);
	Write_Command_Data(0x0010,0x0000);
	Write_Command_Data(0x0011,0x6070);
	Write_Command_Data(0x0005,0x0000);
	Write_Command_Data(0x0006,0x0000);
	Write_Command_Data(0x0016,0xEF1C);
	Write_Command_Data(0x0017,0x0003);
	Write_Command_Data(0x0007,0x0233);
	Write_Command_Data(0x000B,0x0000);
	Write_Command_Data(0x000F,0x0000);
	Write_Command_Data(0x0041,0x0000);
	Write_Command_Data(0x0042,0x0000);
	Write_Command_Data(0x0048,0x0000);
	Write_Command_Data(0x0049,0x013F);
	Write_Command_Data(0x004A,0x0000);
	Write_Command_Data(0x004B,0x0000);
	Write_Command_Data(0x0044,0xEF95);
	Write_Command_Data(0x0045,0x0000);
	Write_Command_Data(0x0046,0x013F);
	Write_Command_Data(0x0030,0x0707);
	Write_Command_Data(0x0031,0x0204);
	Write_Command_Data(0x0032,0x0204);
	Write_Command_Data(0x0033,0x0502);
	Write_Command_Data(0x0034,0x0507);
	Write_Command_Data(0x0035,0x0204);
	Write_Command_Data(0x0036,0x0204);
	Write_Command_Data(0x0037,0x0502);
	Write_Command_Data(0x003A,0x0302);
	Write_Command_Data(0x003B,0x0302);
	Write_Command_Data(0x0023,0x0000);
	Write_Command_Data(0x0024,0x0000);
	Write_Command_Data(0x0025,0x8000);
	Write_Command_Data(0x004f,0x0000);
	Write_Command_Data(0x004e,0x0000);
	Write_Command(0x0022);
	TFT_CS_1;
}

unsigned int Set_color(uint16_t  R, uint16_t G, uint16_t B)
{
	uint16_t temp = (((R & 0xF8)|(G>>5))<<8)|(((G & 0x1C)<<3)|(B>>3));
	return temp;
}

void TFT_Fill(unsigned int color)
{
	unsigned int i,j;
	TFT_CS_0;
	TFT_Set_Address(0,0,239,319);
	Write_Data(color);
	for(i = 0; i <= 319; i++)
	{
		for(j = 0; j <= 239; j++)
		{
			TFT_WR_0;
			TFT_WR_1;
		}
	}
	TFT_CS_1;
}

void TFT_Box(unsigned int x1,unsigned int y1,unsigned int x2,unsigned int y2,unsigned int color)
{
	unsigned int  i,j;
	TFT_CS_0;
	TFT_Set_Address(x1,y1,x2,y2);
	Write_Data(color);
	for(i = y1; i <= y2; i++)
	{
		for(j = x1; j <= x2; j++)
		{
			TFT_WR_0;
			TFT_WR_1;
		}
	}
	TFT_CS_1;
}

void TFT_Dot(unsigned int x,unsigned int y,unsigned int color)
{
	TFT_CS_0;
	TFT_Set_Address(x,y,x,y);
	Write_Data(color);
	TFT_CS_1;
}

void TFT_Line(unsigned int x1,unsigned int y1,unsigned int x2,unsigned int y2,unsigned int color)
{
	int x,y,addx,addy,dx,dy;
	long P;
	unsigned int i;

	dx = fabs(x2-x1);
	dy = fabs(y2-y1);
	x = x1;
	y = y1;

	if(x1 > x2)
	{
		addx = -1;
	}
	else
	{
		addx = 1;
	}

	if(y1 > y2)
	{
		addy = -1;
	}
	else
	{
		addy = 1;
	}


	if(dx >= dy)
	{

		P = (2*dy) - dx;

		for(i = 1; i <= (dx +1); i++)
		{

			TFT_Dot(x,y,color);

			if(P < 0)
			{
				P = P + (2*dy);
				x = (x + addx);
			}
			else
			{
				P = P+(2*dy) - (2*dx);
				x = x + addx;
				y = y + addy;
			}
		}
	}
	else
	{
		P = (2*dx) - dy;

		for(i = 1; i <= (dy +1); i++)
		{

			TFT_Dot(x,y,color);

			if(P<0)
			{
				P = P + (2*dx);
				y = y + addy;
			}
			else
			{
				P = P + (2*dx) - (2*dy);
				x = x + addx;
				y = y + addy;
			}
		}
	}
}


void TFT_H_Line(char x1,char x2,unsigned int y_pos,unsigned int color)
{
	char k;
	for(k = x1; k <= x2; k++)
	{
		TFT_Dot(k,y_pos,color);
	}
}

void TFT_V_Line(unsigned int y1,unsigned int y2,char x_pos,unsigned int color)
{
	unsigned int k;
	for(k = y1; k <= y2; k++)
	{
		TFT_Dot(x_pos,k,color);
	}
}

void TFT_Rectangle(unsigned int x1,unsigned int y1,unsigned int x2,unsigned int y2,unsigned int color)
{
	TFT_H_Line(x1,x2,y1,color);
	TFT_H_Line(x1,x2,y2,color);
	TFT_V_Line(y1,y2,x1,color);
	TFT_V_Line(y1,y2,x2,color);
}


void TFT_Circle(unsigned int x,unsigned int y,char radius,char fill,unsigned int color)
{
	int a_,b_,P;
	a_ = 0;
	b_ = radius;
	P = 1 - radius;
	while (a_ <= b_)
	{
		if(fill == 1)
		{
			TFT_Line(x-a_, y+b_, x+a_, y+b_, color);
			TFT_Line(x-a_, y-b_, x+a_, y-b_, color);
			TFT_Line(x-b_, y+a_, x+b_, y+a_, color);
			TFT_Line(x-b_, y-a_, x+b_, y-a_, color);
		}
		else
		{
			TFT_Dot(a_+x, b_+y, color);
			TFT_Dot(b_+x, a_+y, color);
			TFT_Dot(x-a_, b_+y, color);
			TFT_Dot(x-b_, a_+y, color);
			TFT_Dot(b_+x, y-a_, color);
			TFT_Dot(a_+x, y-b_, color);
			TFT_Dot(x-a_, y-b_, color);
			TFT_Dot(x-b_, y-a_, color);
		}
		if (P < 0 )
		{
			P = (P + 3) + (2* a_);
			a_ ++;
		}
		else
		{
			P = (P + 5) + (2* (a_ - b_));
			a_ ++;
			b_ --;
		}
	}
}

void TFT_Char(char C,unsigned int x,unsigned int y,char DimFont,unsigned int Fcolor,unsigned int Bcolor)
{
	const char *PtrFont;  //aman original line: const char *PtrFont;
	unsigned int Cptrfont, y_new;
	unsigned char font8x8[8];  //aman original line: unsigned int font8x8[8];
	unsigned int font16x16[16];
	unsigned int x_new;
	unsigned char k,i,print1,print2;  //edited breb LINE: char k,i,x_new,x_old,print1,print2;
	unsigned int print3,print4;

	if(DimFont == 8)
	{
		PtrFont = &FONT_8x8[0]; // aman & can be eliminated ;;; default prev line: PtrFont = &FONT_8x8;
		Cptrfont = (C-32)*8;
		PtrFont = PtrFont + Cptrfont;

		TFT_Set_Address(x,y,x,y);
		x_new = x;
		//x_old = x;  //commented by aman
		y_new = y;

		for(k = 0; k <= 7; k++)
		{
			font8x8[k] =pgm_read_byte(PtrFont) ; //*PtrFont;
			PtrFont++;
		}

		for(i = 0; i <= 7; i++)
		{
			for(k = 0; k <= 7; k++)
			{
				print1 = (font8x8[i] & 0x80);
				print2 = print1 >>7;
				if(print2 == 1)
				{
					TFT_Dot(x_new,y_new,Fcolor);
					x_new++;
				}
				else
				{
					TFT_Dot(x_new,y_new,Bcolor);
					x_new++;
					TFT_Set_Address(x_new,y,x_new,y);
				}
				font8x8[i] = font8x8[i] << 1;
			}

			y_new++;
			x_new = x;
			TFT_Set_Address(x,y_new,x,y_new);
		}
	}

	else if(DimFont == 16)
	{
	    PtrFont = &FONT_16x16[0];
		Cptrfont = (C-32)*32;
		PtrFont = PtrFont + Cptrfont;

		TFT_Set_Address(x,y,x,y);
		x_new = x;
		//x_old = x;  //commented my aman
		y_new = y;

		for(k = 0; k <= 15; k++)
		{
			font16x16[k] = pgm_read_byte(PtrFont);//*PtrFont;
			PtrFont++;
			font16x16[k] = (font16x16[k] << 8);
			font16x16[k] = font16x16[k] + pgm_read_byte(PtrFont);//*PtrFont;
			PtrFont++;
		}

		for(i = 0; i <= 15; i++)
		{
			for(k = 0; k <= 15; k++)
			{
				print3 = (font16x16[i] & 0x8000);
				print4 = print3 >>15;

				if(print4 == 1)
				{
					TFT_Dot(x_new,y_new,Fcolor);
					x_new++;
				}
				else
				{
					TFT_Dot(x_new,y_new,Bcolor);
					x_new++;
					TFT_Set_Address(x_new,y,x_new,y);
				}

				font16x16[i] = font16x16[i] << 1;
			}

			y_new++;
			x_new = x;
			TFT_Set_Address(x,y_new,x,y_new);
		}
	}

}

void TFT_Text(const char* S,unsigned int x,unsigned int y,char DimFont,unsigned int Fcolor,unsigned int Bcolor)
{
	int lenght,k;
	char buffer[24];
	lenght = strlen(S);

	for(k = 0; k <= (lenght - 1); k++)
	{
		buffer[k] = S[k];
	}

	if(DimFont == 8)
	{
		for(k = 0; k <= (lenght - 1); k++)
		{
			TFT_Char(buffer[k],x,y,DimFont,Fcolor,Bcolor);
			x = x + 8;
		}
	}
	else if(DimFont == 16)
	{
		for(k = 0; k <= (lenght - 1); k++)
		{
			TFT_Char(buffer[k],x,y,DimFont,Fcolor,Bcolor);
			x = x + 14;  //default is 16 but 14 is to minimize the space
		}
	}
}

void TFT_PutsInt(int32_t val,signed int field_length,unsigned int x,unsigned int y,char DimFont,unsigned int Fcolor,unsigned int Bcolor)
{
	//This function writes a long integer type value to LCD module

	char str[10]={0,0,0,0,0,0,0,0,0,0};
	int i=9,j=0;
	while(val)
	{
		str[i]=val%10;
		val=val/10;
		i--;
	}
	if(field_length==-1)
	while(str[j]==0) j++;
	else
	j=10-field_length;

	if(val<0)
	{
		TFT_Char('-', x, y, DimFont, Fcolor, Bcolor);
		if(DimFont == 8) x+=8;
		else if(DimFont == 16) x+=14; //here 16 is genuine but 14 is to minimize the space between two character
	}

	for(i=j;i<10;i++)
	{
		TFT_Char(48+str[i], x, y, DimFont, Fcolor, Bcolor);
		if(DimFont == 8) x+=8;
		else if(DimFont == 16) x+=14; //here 16 is genuine but 14 is to minimize the space between two character
	}
}


void TFT_Image(unsigned int pos_x,unsigned int pos_y,unsigned int dim_x,unsigned int dim_y,const unsigned int *picture){
	unsigned int x, y;

	TFT_CS_0;
	for(y = pos_y; y < (pos_y + dim_y); y++ ) {
		for(x = pos_x; x < (pos_x + dim_x); x++ ) {

			TFT_Set_Address(x, y, x, y);
			picture++;
			Write_Data(pgm_read_word(picture));
		}
	}
	TFT_CS_1;
}


#endif /* SSD1289_H_ */